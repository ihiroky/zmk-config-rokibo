## boards/shields/rokibo/Kconfig.defconfig
```kconfig
if SHIELD_ROKIBO_RIGHT

config ZMK_KEYBOARD_NAME
    default "rokibo"

config ZMK_SPLIT
    default y

config ZMK_SPLIT_ROLE_CENTRAL
    default y

endif # SHIELD_ROKIBO_RIGHT

if SHIELD_ROKIBO_LEFT

config ZMK_KEYBOARD_NAME
    default "rokibo"

config ZMK_SPLIT
    default y

endif # SHIELD_ROKIBO_LEFT
```

## boards/shields/rokibo/Kconfig.shield
```kconfig
config SHIELD_ROKIBO_LEFT
    def_bool $(shields_list_contains,rokibo_left)

config SHIELD_ROKIBO_RIGHT
    def_bool $(shields_list_contains,rokibo_right)
```
